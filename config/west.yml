## config/west.yml
```yaml
manifest:
  remotes:
    - name: joelspadin
      url-base: https://github.com/joelspadin
    - name: zmkfirmware
      url-base: https://github.com/zmkfirmware
  projects:
    - name: zmk
      remote: joelspadin
      revision: gh-workflow-improvements
      import: app/west.yml
  self:
    path: config
```
